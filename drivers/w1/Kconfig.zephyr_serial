## drivers/w1/Kconfig.zephyr_serial
```kconfig
# Configuration options for the Zephyr serial 1-Wire driver

# Copyright (c) 2022 Thomas Stranger
# SPDX-License-Identifier: Apache-2.0

DT_COMPAT_ZEPHYR_SERIAL := zephyr,w1-serial

config W1_ZEPHYR_SERIAL
	bool "1-wire Serial"
	default y if $(dt_compat_enabled,$(DT_COMPAT_ZEPHYR_SERIAL))
	help
	  This option enables the w1 zephyr serial driver.

	  The bus reset, and bit read and write operations are executed
	  via bytes read and write operations on top of the zephyr
	  serial driver interface.

if W1_ZEPHYR_SERIAL

config W1_ZEPHYR_SERIAL_BIT_TIMEOUT
	int "Bit read timeout in us"
	default 380
	help
	  The bit read timeout specifies how long the driver tries to read the
	  uart byte (1-wire bit data bit).
	  For serial drivers where poll_out does not block until the transfer is
	  complete, it must at least be greater than 87us (10bits / 115200baud).

endif # W1_ZEPHYR_SERIAL
```

## dts/bindings/test/vnd,w1.yaml
```yaml
# Copyright (c) 2022 Thomas Stranger
# SPDX-License-Identifier: Apache-2.0

description: Test W1 master node

compatible: "vnd,w1"

include: [w1-controller.yaml]
```

## tests/drivers/w1/w1_api/dts/bindings/test,w1-dummy-device.yaml
```yaml
# Copyright (c) 2022, Thomas Stranger
# SPDX-License-Identifier: Apache-2.0

description: 1-Wire dummy device

compatible: "test-w1-dummy-device"

include: w1-device.yaml
```
